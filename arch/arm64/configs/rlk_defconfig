## kmodules/rlk_lab/rlk_basic/chapter_16_benos/lab02_setting_el/arch/arm64/Kconfig
```kconfig
config ARM64
	def_bool y
	help
	  ARM 64-bit (AArch64) support.

config 64BIT
	def_bool y

choice
	prompt"Platform selection"
	default ARCH_BCM2835
	help
	  Platform selection.

config ARCH_BCM2835
	bool "Broadcom BCM2835 family"
	help
	This enables support for the Broadcom BCM2837 and BCM2711 SoC.
	These SoCs are used in the Raspberry Pi 3 and 4 devices.

config ARCH_VEXPRESS
	bool "ARMv8 software model (Versatile Express)"
	help
	This enables support for the ARMv8 software model (Versatile
	Express).
endchoice

choice
	prompt "Board selection"
	default BOARD_PI3B

config BOARD_PI3B
	bool "Raspberry 3B"
	depends on ARCH_BCM2835

config BOARD_PI4B
	bool "Raspberry 4B"
	depends on ARCH_BCM2835
endchoice

choice
	prompt "Uart for Pi"
	default PI_PL_UART
	depends on ARCH_BCM2835

config PI_MINI_UART
	bool "mini_uart"
	select DEBUG_ON_EARLY_ASM

config PI_PL_UART
	bool "pl_uart"
	select DEBUG_ON_EARLY_ASM
endchoice

config DEBUG_ON_EARLY_ASM
	bool

#source "kernel/Kconfig"
source "init/Kconfig"
```

## kmodules/rlk_lab/rlk_basic/chapter_16_benos/lab06_add_scheduler/arch/arm64/Kconfig
```kconfig
config ARM64
	def_bool y
	help
	  ARM 64-bit (AArch64) support.

config 64BIT
	def_bool y

choice
	prompt"Platform selection"
	default ARCH_BCM2835
	help
	  Platform selection.

config ARCH_BCM2835
	bool "Broadcom BCM2835 family"
	help
	This enables support for the Broadcom BCM2837 and BCM2711 SoC.
	These SoCs are used in the Raspberry Pi 3 and 4 devices.

config ARCH_VEXPRESS
	bool "ARMv8 software model (Versatile Express)"
	help
	This enables support for the ARMv8 software model (Versatile
	Express).
endchoice

choice
	prompt "Board selection"
	default BOARD_PI3B

config BOARD_PI3B
	bool "Raspberry 3B"
	depends on ARCH_BCM2835

config BOARD_PI4B
	bool "Raspberry 4B"
	depends on ARCH_BCM2835
endchoice

choice
	prompt "Uart for Pi"
	default PI_PL_UART
	depends on ARCH_BCM2835

config PI_MINI_UART
	bool "mini_uart"
	select DEBUG_ON_EARLY_ASM

config PI_PL_UART
	bool "pl_uart"
	select DEBUG_ON_EARLY_ASM
endchoice

config DEBUG_ON_EARLY_ASM
	bool

choice
	prompt "Timer frequency"
	default HZ_250
	help
	Allows the configuration of the timer frequency.

config HZ_100
	bool "100 HZ"
	help
	100 Hz is a typical choice for servers, SMP and NUMA systems
	with lots of processors that may show reduced performance if
	too many timer interrupts are occurring.

config HZ_250
	bool "250 HZ"
	help
	250 Hz is a good compromise choice allowing server performance
	while also showing good interactive responsiveness even
	on SMP and NUMA systems. If you are going to be using NTSC video
	or multimedia, selected 300Hz instead.

config HZ_1000
	bool "1000 HZ"
	help
	1000 Hz is the preferred choice for desktop systems and other
	systems requiring fast interactive responses to events.
endchoice

config HZ
	int
	default 100 if HZ_100
	default 250 if HZ_250
	default 1000 if HZ_1000

#source "kernel/Kconfig"
source "init/Kconfig"
```
